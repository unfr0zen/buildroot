## Config.in
```kconfig
source "$BR2_EXTERNAL_DIAMOND3_PATH/package/diamond3-board/Config.in"
source "$BR2_EXTERNAL_DIAMOND3_PATH/package/starship/Config.in"
source "$BR2_EXTERNAL_DIAMOND3_PATH/package/nest-tools/Config.in"
source "$BR2_EXTERNAL_DIAMOND3_PATH/package/j49-board/Config.in"
source "$BR2_EXTERNAL_DIAMOND3_PATH/package/btop/Config.in"
source "$BR2_EXTERNAL_DIAMOND3_PATH/package/nest-hardware/Config.in"
source "$BR2_EXTERNAL_DIAMOND3_PATH/package/nbnsd/Config.in"
source "$BR2_EXTERNAL_DIAMOND3_PATH/package/jitterentropy-rngd/Config.in"
```

## board/onyx/kernel.its
```
/dts-v1/;
/ {
    description = "Onyx Buildroot Linux";
    #address-cells = <1>;
    images {
        kernel { description = "Linux 7.3.1"; data = /incbin/("zImage");
            type = "kernel"; arch = "arm"; os = "linux"; compression = "none";
            load = <0x80008000>; entry = <0x80008000>;
            hash { algo = "sha256"; };
        };
        ramdisk { description = "Onyx UBIFS root mount"; data = /incbin/("initramfs.cpio.gz");
            type = "ramdisk"; arch = "arm"; os = "linux"; compression = "gzip";
            hash { algo = "sha256"; };
        };
        fdt { description = "Onyx device tree"; data = /incbin/("imx6ul-onyx.dtb");
            type = "flat_dt"; arch = "arm"; compression = "none";
            hash { algo = "sha256"; };
        };
    };
    configurations { default = "Display-4.x";
        Display-4.x { description = "Nest Thermostat E"; kernel = "kernel"; fdt = "fdt"; ramdisk = "ramdisk"; };
    };
};
```

## configs/diamond3_defconfig
```kconfig
BR2_arm=y
BR2_cortex_a9=y
BR2_ARM_ENABLE_NEON=y
BR2_ARM_ENABLE_VFP=y
BR2_ARM_FPU_VFPV3=y
BR2_TOOLCHAIN_BUILDROOT_GLIBC=y
BR2_TOOLCHAIN_BUILDROOT_CXX=y
BR2_KERNEL_HEADERS_7_1=y
BR2_TARGET_GENERIC_HOSTNAME="diamond3"
BR2_TARGET_GENERIC_GETTY_PORT="ttymxc0"
BR2_TARGET_GENERIC_GETTY_BAUDRATE_115200=y
BR2_TARGET_ENABLE_ROOT_LOGIN=y
BR2_TARGET_GENERIC_ROOT_PASSWD=""
BR2_INIT_SYSTEMD=y
BR2_PACKAGE_SYSTEMD_NETWORKD=y
BR2_PACKAGE_SYSTEMD_RESOLVED=n
BR2_INIT_SYSTEMD_VAR_NONE=y
BR2_ROOTFS_OVERLAY="$(BR2_EXTERNAL_DIAMOND3_PATH)/board/common/rootfs_overlay $(BR2_EXTERNAL_DIAMOND3_PATH)/board/diamond3/rootfs_overlay"
BR2_LINUX_KERNEL=y
BR2_LINUX_KERNEL_CUSTOM_VERSION=y
BR2_LINUX_KERNEL_CUSTOM_VERSION_VALUE="7.3.1"
BR2_LINUX_KERNEL_DEFCONFIG="imx_v6_v7"
BR2_LINUX_KERNEL_CONFIG_FRAGMENT_FILES="$(BR2_EXTERNAL_DIAMOND3_PATH)/linux/diamond3.fragment"
BR2_LINUX_KERNEL_UIMAGE=y
BR2_LINUX_KERNEL_UIMAGE_LOADADDR="0x80008000"
BR2_LINUX_KERNEL_DTS_SUPPORT=y
BR2_LINUX_KERNEL_CUSTOM_DTS_PATH="$(BR2_EXTERNAL_DIAMOND3_PATH)/board/diamond3/imx6sx-diamond3.dts"
BR2_LINUX_KERNEL_NEEDS_HOST_OPENSSL=y
BR2_TARGET_ROOTFS_UBIFS=y
BR2_TARGET_ROOTFS_UBIFS_LEBSIZE=0x1f000
BR2_TARGET_ROOTFS_UBIFS_MINIOSIZE=0x800
BR2_TARGET_ROOTFS_UBIFS_MAXLEBCNT=4064
BR2_TARGET_ROOTFS_UBI=y
BR2_TARGET_ROOTFS_UBI_PEBSIZE=0x20000
BR2_TARGET_ROOTFS_UBI_SUBSIZE=2048
BR2_PACKAGE_BUSYBOX_SHOW_OTHERS=y
BR2_PACKAGE_IPROUTE2=y
BR2_PACKAGE_IW=y
BR2_PACKAGE_WPA_SUPPLICANT=y
BR2_PACKAGE_WPA_SUPPLICANT_CLI=y
BR2_PACKAGE_MTD=y
BR2_PACKAGE_MTD_UBIATTACH=y
BR2_PACKAGE_MTD_UBIFORMAT=y
BR2_PACKAGE_MTD_UBIUPDATEVOL=y
BR2_PACKAGE_USBUTILS=y
BR2_PACKAGE_I2C_TOOLS=y
BR2_PACKAGE_EVTEST=y
BR2_PACKAGE_LIBGPIOD=y
BR2_PACKAGE_LIBGPIOD_TOOLS=y
BR2_PACKAGE_DROPBEAR=y
BR2_PACKAGE_NANO=y
BR2_PACKAGE_LESS=y

BR2_ROOTFS_POST_BUILD_SCRIPT="$(BR2_EXTERNAL_DIAMOND3_PATH)/board/diamond3/post_build.sh"

BR2_PACKAGE_DIAMOND3_BOARD=y

BR2_ROOTFS_POST_IMAGE_SCRIPT="$(BR2_EXTERNAL_DIAMOND3_PATH)/board/diamond3/post_image.sh"

BR2_GLOBAL_PATCH_DIR="$(BR2_EXTERNAL_DIAMOND3_PATH)/patches"

BR2_DL_DIR="$(BR2_EXTERNAL_DIAMOND3_PATH)/dl"
BR2_TARGET_ROOTFS_UBI_USE_CUSTOM_CONFIG=y
BR2_TARGET_ROOTFS_UBI_CUSTOM_CONFIG_FILE="$(BR2_EXTERNAL_DIAMOND3_PATH)/board/diamond3/ubinize.cfg"
BR2_PACKAGE_MTD_UBIRSVOL=y

BR2_LINUX_KERNEL_XZ=y

BR2_PACKAGE_WIRELESS_REGDB=y
BR2_PACKAGE_BASH=y
BR2_PACKAGE_HTOP=y
BR2_PACKAGE_PROCPS_NG=y
BR2_PACKAGE_BUSYBOX_CONFIG_FRAGMENT_FILES="$(BR2_EXTERNAL_DIAMOND3_PATH)/board/common/busybox.fragment"
BR2_PACKAGE_GREP=y
BR2_PACKAGE_UTIL_LINUX_BINARIES=y
BR2_PACKAGE_STARSHIP=y
BR2_PACKAGE_KBD=y

BR2_PACKAGE_NEST_TOOLS=y
BR2_PACKAGE_NEOFETCH=y
BR2_TARGET_GENERIC_GETTY_TERM="xterm-256color"
BR2_PACKAGE_BTOP=y
BR2_PACKAGE_NEST_HARDWARE=y
BR2_PACKAGE_LM_SENSORS=y
BR2_PACKAGE_LM_SENSORS_SENSORS=y
BR2_PACKAGE_SPI_TOOLS=y

BR2_PACKAGE_IPERF3=y
BR2_PACKAGE_AVAHI=y
# BR2_PACKAGE_AVAHI_AUTOIPD is not set
BR2_PACKAGE_AVAHI_DAEMON=y
BR2_PACKAGE_AVAHI_DEFAULT_SERVICES=y
BR2_PACKAGE_LIBDRM=y
BR2_PACKAGE_LIBDRM_INSTALL_TESTS=y
BR2_PACKAGE_MESA3D=y
BR2_PACKAGE_MESA3D_GALLIUM_DRIVER_ETNAVIV=y
BR2_PACKAGE_MESA3D_OPENGL_EGL=y
BR2_PACKAGE_MESA3D_OPENGL_ES=y
BR2_PACKAGE_KMSCUBE=y
BR2_PACKAGE_BLUEZ5_UTILS=y
BR2_PACKAGE_BLUEZ5_UTILS_CLIENT=y
BR2_PACKAGE_BLUEZ5_UTILS_MONITOR=y
BR2_PACKAGE_BLUEZ5_UTILS_TOOLS=y
BR2_PACKAGE_NBNSD=y
BR2_PACKAGE_SYSTEMD_RANDOMSEED=y
BR2_PACKAGE_JITTERENTROPY_RNGD=y
```

## configs/onyx_defconfig
```kconfig
BR2_arm=y
BR2_cortex_a7=y
BR2_ARM_ENABLE_NEON=y
BR2_ARM_ENABLE_VFP=y
BR2_ARM_FPU_VFPV3=y
BR2_TOOLCHAIN_EXTERNAL=y
BR2_TOOLCHAIN_EXTERNAL_CUSTOM=y
BR2_TOOLCHAIN_EXTERNAL_PREINSTALLED=y
BR2_TOOLCHAIN_EXTERNAL_PATH="$(BR2_EXTERNAL_DIAMOND3_PATH)/output/host"
BR2_TOOLCHAIN_EXTERNAL_CUSTOM_PREFIX="arm-buildroot-linux-gnueabihf"
BR2_TOOLCHAIN_EXTERNAL_GCC_15=y
BR2_TOOLCHAIN_EXTERNAL_HEADERS_7_1=y
BR2_TOOLCHAIN_EXTERNAL_CUSTOM_GLIBC=y
BR2_TOOLCHAIN_EXTERNAL_CXX=y
BR2_TOOLCHAIN_EXTERNAL_WCHAR=y
BR2_TOOLCHAIN_EXTERNAL_HAS_SSP=y
BR2_TOOLCHAIN_EXTERNAL_HAS_SSP_STRONG=y
BR2_TARGET_GENERIC_HOSTNAME="onyx"
BR2_TARGET_GENERIC_GETTY_PORT="ttymxc0"
BR2_TARGET_GENERIC_GETTY_BAUDRATE_115200=y
BR2_TARGET_ENABLE_ROOT_LOGIN=y
BR2_TARGET_GENERIC_ROOT_PASSWD=""
BR2_INIT_SYSTEMD=y
BR2_PACKAGE_SYSTEMD_NETWORKD=y
BR2_PACKAGE_SYSTEMD_RESOLVED=n
BR2_INIT_SYSTEMD_VAR_NONE=y
BR2_ROOTFS_OVERLAY="$(BR2_EXTERNAL_DIAMOND3_PATH)/board/common/rootfs_overlay $(BR2_EXTERNAL_DIAMOND3_PATH)/board/onyx/rootfs_overlay"
BR2_LINUX_KERNEL=y
BR2_LINUX_KERNEL_CUSTOM_VERSION=y
BR2_LINUX_KERNEL_CUSTOM_VERSION_VALUE="7.3.1"
BR2_LINUX_KERNEL_DEFCONFIG="imx_v6_v7"
BR2_LINUX_KERNEL_CONFIG_FRAGMENT_FILES="$(BR2_EXTERNAL_DIAMOND3_PATH)/linux/onyx.fragment"
BR2_LINUX_KERNEL_ZIMAGE=y
BR2_PACKAGE_HOST_UBOOT_TOOLS=y
BR2_PACKAGE_HOST_UBOOT_TOOLS_FIT_SUPPORT=y
BR2_LINUX_KERNEL_UIMAGE_LOADADDR="0x80008000"
BR2_LINUX_KERNEL_DTS_SUPPORT=y
BR2_LINUX_KERNEL_CUSTOM_DTS_PATH="$(BR2_EXTERNAL_DIAMOND3_PATH)/board/onyx/imx6ul-onyx.dts"
BR2_LINUX_KERNEL_NEEDS_HOST_OPENSSL=y
BR2_TARGET_ROOTFS_UBIFS=y
BR2_TARGET_ROOTFS_UBIFS_LEBSIZE=0x1f000
BR2_TARGET_ROOTFS_UBIFS_MINIOSIZE=0x800
BR2_TARGET_ROOTFS_UBIFS_MAXLEBCNT=4064
BR2_TARGET_ROOTFS_UBI=y
BR2_TARGET_ROOTFS_UBI_PEBSIZE=0x20000
BR2_TARGET_ROOTFS_UBI_SUBSIZE=2048
BR2_PACKAGE_BUSYBOX_SHOW_OTHERS=y
BR2_PACKAGE_IPROUTE2=y
BR2_PACKAGE_IW=y
BR2_PACKAGE_WPA_SUPPLICANT=y
BR2_PACKAGE_WPA_SUPPLICANT_CLI=y
BR2_PACKAGE_MTD=y
BR2_PACKAGE_MTD_UBIATTACH=y
BR2_PACKAGE_MTD_UBIFORMAT=y
BR2_PACKAGE_MTD_UBIUPDATEVOL=y
BR2_PACKAGE_USBUTILS=y
BR2_PACKAGE_I2C_TOOLS=y
BR2_PACKAGE_EVTEST=y
BR2_PACKAGE_LIBGPIOD=y
BR2_PACKAGE_LIBGPIOD_TOOLS=y
BR2_PACKAGE_DROPBEAR=y
BR2_PACKAGE_NANO=y
BR2_PACKAGE_LESS=y

BR2_ROOTFS_POST_BUILD_SCRIPT="$(BR2_EXTERNAL_DIAMOND3_PATH)/board/onyx/post_build.sh"

BR2_PACKAGE_ONYX_BOARD=y

BR2_ROOTFS_POST_IMAGE_SCRIPT="$(BR2_EXTERNAL_DIAMOND3_PATH)/board/onyx/post_image.sh"

BR2_GLOBAL_PATCH_DIR="$(BR2_EXTERNAL_DIAMOND3_PATH)/patches"

BR2_DL_DIR="$(BR2_EXTERNAL_DIAMOND3_PATH)/dl"
BR2_TARGET_ROOTFS_UBI_USE_CUSTOM_CONFIG=y
BR2_TARGET_ROOTFS_UBI_CUSTOM_CONFIG_FILE="$(BR2_EXTERNAL_DIAMOND3_PATH)/board/onyx/ubinize.cfg"
BR2_PACKAGE_MTD_UBIRSVOL=y

BR2_LINUX_KERNEL_XZ=y

BR2_PACKAGE_WIRELESS_REGDB=y
BR2_PACKAGE_BASH=y
BR2_PACKAGE_HTOP=y
BR2_PACKAGE_PROCPS_NG=y
BR2_PACKAGE_BUSYBOX_CONFIG_FRAGMENT_FILES="$(BR2_EXTERNAL_DIAMOND3_PATH)/board/common/busybox.fragment"
BR2_PACKAGE_GREP=y
BR2_PACKAGE_UTIL_LINUX_BINARIES=y
BR2_PACKAGE_STARSHIP=y
BR2_PACKAGE_KBD=y

BR2_PACKAGE_NEST_TOOLS=y
BR2_PACKAGE_NEOFETCH=y
BR2_TARGET_GENERIC_GETTY_TERM="xterm-256color"
BR2_PACKAGE_BTOP=y
BR2_PACKAGE_NEST_HARDWARE=y
BR2_PACKAGE_LM_SENSORS=y
BR2_PACKAGE_LM_SENSORS_SENSORS=y
BR2_PACKAGE_SPI_TOOLS=y

BR2_PACKAGE_IPERF3=y
BR2_PACKAGE_AVAHI=y
# BR2_PACKAGE_AVAHI_AUTOIPD is not set
BR2_PACKAGE_AVAHI_DAEMON=y
BR2_PACKAGE_AVAHI_DEFAULT_SERVICES=y
BR2_PACKAGE_BLUEZ5_UTILS=y
BR2_PACKAGE_BLUEZ5_UTILS_CLIENT=y
BR2_PACKAGE_BLUEZ5_UTILS_MONITOR=y
BR2_PACKAGE_BLUEZ5_UTILS_TOOLS=y
BR2_PACKAGE_NBNSD=y
BR2_PACKAGE_SYSTEMD_RANDOMSEED=y
BR2_PACKAGE_JITTERENTROPY_RNGD=y

BR2_PACKAGE_HOST_DTC=y


# BR2_TOOLCHAIN_EXTERNAL_INET_RPC is not set

BR2_PACKAGE_FREESCALE_IMX=y
BR2_PACKAGE_FREESCALE_IMX_PLATFORM_IMX6UL=y
BR2_PACKAGE_FIRMWARE_IMX=y
```

## package/btop/Config.in
```kconfig
config BR2_PACKAGE_BTOP
 bool "btop resource monitor"
 depends on BR2_arm && BR2_ARM_CPU_ARMV7A
 help
   Official statically linked ARMv7 musl release of btop.
```

## package/diamond3-board/Config.in
```kconfig
config BR2_PACKAGE_DIAMOND3_BOARD
 bool "Diamond3 board drivers"
 depends on BR2_LINUX_KERNEL
```

## package/ioquake3/Config.in
```kconfig
config BR2_PACKAGE_IOQUAKE3
 bool "ioquake3"
 depends on BR2_PACKAGE_HAS_LIBEGL
 depends on BR2_PACKAGE_HAS_LIBGLES
 depends on BR2_PACKAGE_HAS_LIBGBM
 depends on BR2_TOOLCHAIN_HAS_THREADS
 depends on !BR2_STATIC_LIBS
 select BR2_PACKAGE_JPEG
 select BR2_PACKAGE_ZLIB
 select BR2_PACKAGE_SDL2
 select BR2_PACKAGE_SDL2_OPENGLES
 select BR2_PACKAGE_SDL2_KMSDRM
 help
   Quake III Arena engine with the OpenGL ES 2 renderer and KMS display.
   Game data must be supplied separately.
```

## package/j49-board/Config.in
```kconfig
config BR2_PACKAGE_J49_BOARD
 bool "J49 board drivers"
 depends on BR2_LINUX_KERNEL
```

## package/j49-uboot/Config.in
```kconfig
config BR2_PACKAGE_J49_UBOOT
 bool "J49 U-Boot"
 depends on BR2_arm
 select BR2_PACKAGE_J49_XLOADER
```

## package/jitterentropy-rngd/Config.in
```kconfig
config BR2_PACKAGE_JITTERENTROPY_RNGD
 bool "jitterentropy-rngd"
 depends on BR2_TOOLCHAIN_HAS_THREADS
 help
   Seed the kernel random pool using the Jitter RNG's checked noise source.
```

## package/nbnsd/Config.in
```kconfig
config BR2_PACKAGE_NBNSD
 bool "nbnsd"
 help
   Minimal NetBIOS hostname responder for UDP port 137.
```

## package/nest-hardware/Config.in
```kconfig
config BR2_PACKAGE_NEST_HARDWARE
 bool "Nest hardware telemetry and GPIO interfaces"
 depends on BR2_LINUX_KERNEL
```

## package/onyx-board/Config.in
```kconfig
config BR2_PACKAGE_ONYX_BOARD
 bool "Onyx board drivers"
 depends on BR2_LINUX_KERNEL
```

## package/quake3-demo/Config.in
```kconfig
config BR2_PACKAGE_QUAKE3_DEMO
 bool "Quake III Arena demo data"
 depends on BR2_PACKAGE_IOQUAKE3
 help
   Install the public Quake III Arena demo maps and assets.
   The data uses id Software's demo license.
```

## package/starship/Config.in
```kconfig
config BR2_PACKAGE_STARSHIP
 bool "Starship prompt"
 depends on BR2_arm && BR2_ARM_EABIHF
 help
   Official ARM hard-float musl release of the Starship shell prompt.
```
